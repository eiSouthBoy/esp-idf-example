## 002-button/main/Kconfig.projbuild
```kconfig
menu "Example Button"

    config LED_GPIO_NUM
        int "gpio pin"
        prompt "set led gpio"
        range 0 34
        default 4
        help
            This is help message
    config BUTTON_GPIO_NUM
        int "gpio pin"
        prompt "set button gpio"
        range 0 39
        default 0
        help
            This is help message

endmenu
```

## 003-wifi-softap/main/Kconfig.projbuild
```kconfig
menu "Example AP Configuration"

    config ESP_WIFI_SSID
        string "WiFi SSID"
        default "ESP32"
        help
            SSID (network name) for the example to connect to.

    config ESP_WIFI_PASSWORD
        string "WiFI Password"
        default "12345678"
        help
            WiFi Password (WPA or WPA2) for the example to use.
    
    config ESP_WIFI_CHANNEL
        int "WiFi Channel"
        range 1 13
        default 1
        help
            WiFi Channel (network channel) for the example to use.

    config ESP_MAX_STA_CONN
        int "Maximum STA connections"
        default 4
        help
            Maximum number of the STA connection to AP. 

    choice
        prompt "Select the security mode that will be used by the AP."
        default ESP_WIFI_AUTH_MODE_WPA_WPA2_PSK
        
        config ESP_WIFI_AUTH_MODE_OPEN
            bool "authenticate mode : open"
            select SECURITY_MODE
        config ESP_WIFI_AUTH_MODE_WEP
            bool "authenticate mode : WEP"
            select SECURITY_MODE
        config ESP_WIFI_AUTH_MODE_WPA_PSK
            bool "authenticate mode : WPA_PSK"
            select SECURITY_MODE
        config ESP_WIFI_AUTH_MODE_WPA2_PSK
            bool "authenticate mode : WPA2_PSK"
            select SECURITY_MODE
        config ESP_WIFI_AUTH_MODE_WPA_WPA2_PSK
            bool "authenticate mode : WPA_WPA2_PSK"
            select SECURITY_MODE
        config ESP_WIFI_AUTH_MODE_WPA3_PSK
            bool "authenticate mode : WPA3_PSK"
            select SECURITY_MODE
        config ESP_WIFI_AUTH_MODE_WPA2_WPA3_PSK
            bool "authenticate mode : WPA2_WPA3_PSK"
            select SECURITY_MODE
    endchoice

    # 定义一个整数变量来存储选择的结果
    config SECURITY_MODE
        int
        default 0 if ESP_WIFI_AUTH_MODE_OPEN
        default 1 if ESP_WIFI_AUTH_MODE_WEP
        default 2 if ESP_WIFI_AUTH_MODE_WPA_PSK
        default 3 if ESP_WIFI_AUTH_MODE_WPA2_PSK
        default 4 if ESP_WIFI_AUTH_MODE_WPA_WPA2_PSK
        default 6 if ESP_WIFI_AUTH_MODE_WPA3_PSK
        default 7 if ESP_WIFI_AUTH_MODE_WPA2_WPA3_PSK
       
        help
        This variable stores the selected security mode as an integer:
        0 - OPEN
        1 - WEP
        2 - WPA-PSK
        3 - WPA2-PSK
        4 - WPA-WPA2-PSK
        6 - WPA3-PSK
        7 - WPA2-WPA3-PSK


endmenu
```

## 006-wifi-iperf/03-iperf-ble/sdkconfig.defaults
```kconfig
CONFIG_ESPTOOLPY_FLASHSIZE_4MB=y
CONFIG_PARTITION_TABLE_CUSTOM=y
CONFIG_PARTITION_TABLE_CUSTOM_FILENAME="partitions.csv"
CONFIG_PARTITION_TABLE_FILENAME="partitions.csv"


CONFIG_BT_ENABLED=y
CONFIG_BT_BLE_50_FEATURES_SUPPORTED=n
CONFIG_BT_BLE_42_FEATURES_SUPPORTED=y
# CONFIG_BT_LE_50_FEATURE_SUPPORT is not used on ESP32, ESP32-C3 and ESP32-S3.
CONFIG_BT_LE_50_FEATURE_SUPPORT=n

# iperf 
CONFIG_ESP_SYSTEM_EVENT_TASK_STACK_SIZE=4096

CONFIG_FREERTOS_UNICORE=n
CONFIG_FREERTOS_HZ=1000

CONFIG_ESP_INT_WDT=n
CONFIG_ESP_TASK_WDT_EN=n

CONFIG_LWIP_ETHARP_TRUST_IP_MAC=n
CONFIG_LWIP_IRAM_OPTIMIZATION=y
CONFIG_LWIP_TCPIP_TASK_PRIO=23

CONFIG_IPERF_TRAFFIC_TASK_PRIORITY=23
CONFIG_IPERF_REPORT_TASK_PRIORITY=24
CONFIG_COMPILER_OPTIMIZATION_PERF=y
```

## 008-tcp/01-tcp-server/main/Kconfig.projbuild
```kconfig
menu "Example Configuration"

    # 选择 IP 类型，默认选择IPv4
    config EXAMPLE_IPV4
        bool "IPV4"
        default y
        depends on LWIP_IPV4

    config EXAMPLE_IPV6
        bool "IPV6"
        default n
        select EXAMPLE_CONNECT_IPV6
    # 选择 监听端口，默认选择 3333 端口
    config EXAMPLE_PORT
        int "Port"
        range 0 65535
        default 3333
        help
            Local port the example server will listen on.

    # 设置保活时间，默认5秒
    config EXAMPLE_KEEPALIVE_IDLE
        int "TCP keep-alive idle time(s)"
        default 5
        help
            Keep-alive idle time. In idle time without receiving any data from peer, will send keep-alive probe packet
    # 设置保活间隔，默认5秒
    config EXAMPLE_KEEPALIVE_INTERVAL
        int "TCP keep-alive interval time(s)"
        default 5
        help
            Keep-alive probe packet interval time.
    # 设置保活重试次数，默认3次
    config EXAMPLE_KEEPALIVE_COUNT
        int "TCP keep-alive packet retry send counts"
        default 3
        help
            Keep-alive probe packet retry count.
endmenu
```

## 011-wifi-wps/main/Kconfig.projbuild
```kconfig
menu "Example Configuration"

    choice EXAMPLE_WPS_TYPE
        prompt "WPS mode"
        default EXAMPLE_WPS_TYPE_PBC
        help
            WPS type for the esp32 to use.

        config EXAMPLE_WPS_TYPE_PBC
            bool "PBC"
        config EXAMPLE_WPS_TYPE_PIN
            bool "PIN"
        config EXAMPLE_WPS_TYPE_DISABLE
            bool "disable"
    endchoice

    # SoftAP 的相关配置
    menu "SoftAP Configuration"
        comment "SoftAP Configuration"

        config ESP_WIFI_AP_SSID
            string "WiFi AP SSID"
            default "ESP32"
            help
                SSID (network name) of the AP for the example to connect to.

        config ESP_WIFI_AP_PASSWORD
            string "WiFi AP Password"
            default "12345678"
            help
                WiFi password of the AP for the example to use.

        config ESP_WIFI_AP_CHANNEL
            int "WiFi AP Channel"
            range 1 14
            default 1
            help
                WiFi channel (network channel) of the AP for the example to use.

        config ESP_MAX_STA_CONN_AP
            int "Maximal STA connections"
            default 4
            help
                Max number of the STA connects to AP.        

    endmenu

endmenu
```

## 013-captive-portal/main/Kconfig.projbuild
```kconfig
menu "Example Configuration"

    config ESP_WIFI_SSID
        string "esp32 ap ssid"
        default "ESP32-Captive-Portal"
        help
            SSID (network name) to set up the softAP with.

    config ESP_WIFI_PASSWORD
        string "esp32 ap password"
        default ""
        help
            WiFi password (WPA or WPA2) for the example to use for the softAP.

    config ESP_MAX_STA_CONN
        int "Maximal STA connections"
        default 4
        help
            Max number of the STA connects to AP.
endmenu
```

## 013-captive-portal/sdkconfig.defaults
```kconfig
CONFIG_HTTPD_MAX_REQ_HDR_LEN=1024
CONFIG_LWIP_MAX_SOCKETS=16
CONFIG_ESPTOOLPY_FLASHSIZE_4MB=y
```

## 018-ble/04-wifi-ble-scan/sdkconfig.defaults
```kconfig
CONFIG_ESPTOOLPY_FLASHSIZE_4MB=y

CONFIG_PARTITION_TABLE_CUSTOM=y
CONFIG_PARTITION_TABLE_CUSTOM_FILENAME="partitions.csv"
CONFIG_PARTITION_TABLE_FILENAME="partitions.csv"

CONFIG_BT_ENABLED=y
CONFIG_BT_BLE_50_FEATURES_SUPPORTED=n
CONFIG_BT_BLE_42_FEATURES_SUPPORTED=y
# CONFIG_BT_LE_50_FEATURE_SUPPORT is not used on ESP32, ESP32-C3 and ESP32-S3.
CONFIG_BT_LE_50_FEATURE_SUPPORT=n
```

## 020-wifi-espnow/01-espnow/main/Kconfig.projbuild
```kconfig
menu "Example Configuration"

    # ESPNOW 默认WiFi模式选择：STA
    choice ESPNOW_WIFI_MODE
        prompt "WiFi mode"
        default ESPNOW_WIFI_MODE_STATION
        help
            WiFi mode(station or softap).

        config ESPNOW_WIFI_MODE_STATION
            bool "Station"
        config ESPNOW_WIFI_MODE_STATION_SOFTAP
            bool "Softap"
    endchoice

    # 对于发送设备和接受设备的 PMK 需要一样
    config ESPNOW_PMK
        string "ESPNOW primary master key"
        default "pmk1234567890123"
        help
            ESPNOW primary master for the example to use. 
            The length of ESPNOW primary master must be 16 bytes.

    # 对于发送设备和接受设备的 LMK 需要一样
    config ESPNOW_LMK
        string "ESPNOW local master key"
        default "lmk1234567890123"
        help
            ESPNOW local master for the example to use. 
            The length of ESPNOW local master must be 16 bytes.

    # 对于发送设备和接受设备的 WiFi信道 需要一样，默认为1信道
    config ESPNOW_CHANNEL
        int "Channel"
        default 1
        range 0 14
        help
            The channel on which sending and receiving ESPNOW data.

    # 发送计数器上限
    config ESPNOW_SEND_COUNT
        int "Send count"
        default 100
        range 1 65535
        help
            Total count of unicast ESPNOW data to be sent.

    # 发送延时
    config ESPNOW_SEND_DELAY
        int "Send delay"
        default 1000
        range 0 65535
        help
            Delay between sending two ESPNOW data, unit: ms.

    # 发送长度
    config ESPNOW_SEND_LEN
        int "Send len"
        range 10 250
        default 20
        help
            Length of ESPNOW data to be sent, unit: byte.

    # 是否启动长距离通信，默认不开启
    config ESPNOW_ENABLE_LONG_RANGE
        bool "Enable Long Range"
        default "n"
        help
            When enable long range, the PHY rate of ESP32 will be 512Kbps or 256Kbps

    # 是否启用省电模式，默认不开启
    config ESPNOW_ENABLE_POWER_SAVE
        bool "Enable ESPNOW Power Save"
        default "n"
        select ESP_WIFI_STA_DISCONNECTED_PM_ENABLE
        depends on ESPNOW_WIFI_MODE_STATION
        help
            With ESPNOW power save enabled, chip would be able to wakeup and sleep periodically
            Notice ESP_WIFI_STA_DISCONNECTED_PM_ENABLE is essential at Wi-Fi disconnected

    # 唤醒窗口
    config ESPNOW_WAKE_WINDOW
        int "ESPNOW wake window, unit in millisecond"
        range 0 65535
        default 50
        depends on ESPNOW_ENABLE_POWER_SAVE
        help
            ESPNOW wake window

    # 唤醒间隔
    config ESPNOW_WAKE_INTERVAL
        int "ESPNOW wake interval, unit in millisecond"
        range 1 65535
        default 100
        depends on ESPNOW_ENABLE_POWER_SAVE
        help
            ESPNOW wake interval

endmenu
```

## 021-wifi-channel/main/Kconfig.projbuild
```kconfig
menu "Example Configuration"

    config EXAMPLE_SCAN_LIST_SIZE
        int "Max size of scan list"
        range 0 20
        default 10
        help
            The size of array that will be used to retrieve the list 
            of access points.
    config WIFI_SIDEBAND_WIDTH
    int "wifi sideband width"
    range 0 30
    default 20
    help
      wifi sideband width, wifi and zigbee nearby

endmenu
```

## 026-sntp/main/Kconfig.projbuild
```kconfig
menu "Example Configuration"

    # sntp 时间服务器
    config SNTP_TIME_SERVER
        string "SNTP server name"
        default "pool.ntp.org"
        help
            Hostname of the main SNTP server.

    # sntp 时间同步方式
    choice SNTP_TIME_SYNC_METHOD
        prompt "Time synchronization method"
        default SNTP_TIME_SYNC_METHOD_IMMED
        help
            Time synchronization method.

        config SNTP_TIME_SYNC_METHOD_IMMED
            bool "update time immediately when received"
        config SNTP_TIME_SYNC_METHOD_SMOOTH
            bool "update time with smooth method (adjtime)"
        config SNTP_TIME_SYNC_METHOD_CUSTOM
            bool "custom implementation"
    endchoice

endmenu
```

## 031-ethernet-iperf/main/Kconfig.projbuild
```kconfig
menu "Example Configuration"

    # 是否存储历史命令到flash
    config EXAMPLE_STORE_HISTORY
        bool "Store command history in flash"
        default y
        help
            Linenoise line editing library provides functions to save and load
            command history. If this option is enabled, initalizes a FAT filesystem
            and uses it to store command history.
endmenu
```

## 034-mdns/main/Kconfig.projbuild
```kconfig
menu "Example Configuration"

    orsource "$IDF_PATH/examples/common_components/env_caps/$IDF_TARGET/Kconfig.env_caps"

    # 主机名
    config MDNS_HOSTNAME
        string "mDNS Hostname"
        default "esp32-mdns"
        help
            mDNS Hostname for example to use

    # 实例名
    config MDNS_INSTANCE
        string "mDNS Instance Name"
        default "ESP32 with mDNS"
        help
            mDNS Instance Name for example to use

    # 委托主机名
    config MDNS_PUBLISH_DELEGATE_HOST
        bool "Publish a delegated host"
        help
            Enable publishing a delegated host other than ESP32.
            The example will also add a mock service for this host.

    # 解析服务
    config MDNS_RESOLVE_TEST_SERVICES
        bool "Resolve test services"
        default n
        help
            Enable resolving test services on startup.
            These services are advertized and evaluated in automated tests.
            When executed locally, these will not be resolved and warnings appear in the log.
            Please set to false to disable initial querying to avoid warnings.

    # 主机名后缀
    config MDNS_ADD_MAC_TO_HOSTNAME
        bool "Add mac suffix to hostname"
        default n
        help
            If enabled, a portion of MAC address is added to the hostname, this is used
            for evaluation of tests in CI

    # 查询按键GPIO
    config MDNS_BUTTON_GPIO
        int "Button GPIO to trigger querries"
        range ENV_GPIO_RANGE_MIN ENV_GPIO_IN_RANGE_MAX
        default 0
        help
            Set the GPIO number used as mDNS test button

    # 自定义网络接口
    config MDNS_ADD_CUSTOM_NETIF
        bool "Add user netif to mdns service"
        default n
        help
            If enabled, we try to add a custom netif to mdns service.
            Note that for using with common connection example code, we have to disable
            all predefined interfaces in mdns component setup (since we're adding one
            of the default interfaces)

endmenu
```

## 038-uart-to-uart/main/Kconfig.projbuild
```kconfig
menu "Example Uart-to-Uart Configuration"
    menu "UART Module"

        config UART_BAUD_RATE
            int "UART0 and UART1 communication speed"
            range 1200 115200
            default 115200
            help
                UART0 and UART1 communication speed for Modbus example.
                115200 BAUD is default on Dongle-M.

        config UART0_TXD
            int "UART0 TXD pin number"
            range 1 39
            default 1
            help
                GPIO number for UART0 TX pin. GPIO1 is default on Dongle-M.
        
        config UART0_RXD
            int "UART0 RXD pin number"
            range 1 39
            default 3
            help
                GPIO number for UART1 RX pin. GPIO3 is default on Dongle-M.


        config UART2_TXD
            int "UART2 TXD pin number"
            range 1 39
            default 17
            help
                GPIO number for UART2 TX pin. GPIO17 is default on Dongle-M.
        
        config UART2_RXD
            int "UART2 RXD pin number"
            range 1 39
            default 13
            help
                GPIO number for UART2 RX pin. GPIO16 is default on Dongle-M.
                With the last PCB version, the UART2_RXD is GPIO16, but now is GPIO13 

    endmenu

endmenu
```
